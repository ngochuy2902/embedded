//74HC595 ST Latch
const int latchPin = 11;
//74HC595 SH clock
const int clockPin = 10;
//74HC595 data
const int dataPin = 12;
//IC count HC595
const int HC595_COUNT = 2;
byte ledStatus[HC595_COUNT] = {0, 0};
char characterHEX[][8] = {
  {0x18, 0x3C, 0x66, 0x66, 0x7E, 0x66, 0x66, 0x66}, //A
  {0x78, 0x64, 0x68, 0x78, 0x64, 0x66, 0x66, 0x7C}, //B
  {0x3C, 0x62, 0x60, 0x60, 0x60, 0x62, 0x62, 0x3C}, //C
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  {0x00, 0x00, 0x00, 0x00, 0x00, 0x00, 0x00, 0x00}, // kho?ng tr?ng
};
int row[] = {1, 2, 4, 8, 16, 32, 64, 128};
void setup() {
  pinMode(latchPin, OUTPUT);
  pinMode(clockPin, OUTPUT);
  pinMode(dataPin, OUTPUT);
  Serial.begin(9600);

}
void fillValueToArray(byte value) {
  for (int i = 0; i < HC595_COUNT; i++) {
    ledStatus[i] = value;
  }
}
void shiftOutHC595(int dataPin, int clockPin, byte ledStatus[]) {
  digitalWrite(latchPin, LOW);
  for (int i = 0; i < HC595_COUNT; i++) {
    shiftOut(dataPin, clockPin, MSBFIRST, ledStatus[i]);
  }
  digitalWrite(latchPin, HIGH);
}


void loop() {
  fillValueToArray(0);
  putString("HO NGOC HUY ", 12);

}

void putString(char *s, int length)
{
  int count = 0;
  char ch1 = *s;
  char ch2 = *(s + 1);
  unsigned char i, j, temp[8];
  while (ch1 && ch2) {
    if (ch1 == 32) ch1 = 91;
    if (ch2 == 32) ch2 = 91;
    for (i = 0; i < 8; i++) {
      for (j = 0; j < 8; j++)
        temp[j] = (characterHEX[ch1 - 65][j] << i) | (characterHEX[ch2 - 65][j] >> (7 - i));
      putChar(temp);
    }
    count++;
    Serial.println(count);

    ch1 = *(s + count);
    if (count == length - 1)
    {
      count = -1;
      ch2 = *s;
    }
    else
      ch2 = *(s + count + 1);
  }
}
void putChar(unsigned char image[]) {
  unsigned long temp = millis();
  while (true)
  {
    int row[] = {1, 2, 4, 8, 16, 32, 64, 128};
    for (int j = 0; j < 8; j++) {
      ledStatus[0] = ~image[j];
      ledStatus[1] = row[j];
      shiftOutHC595(dataPin, clockPin, ledStatus);
      delay(1);
    }
    //delay(1000);
    if (millis() - temp >= 150)
      break;
  }
}
